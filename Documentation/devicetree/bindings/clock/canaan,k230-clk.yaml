## Documentation/devicetree/bindings/clock/canaan,k230-clk.yaml
```yaml
# SPDX-License-Identifier: (GPL-2.0-only OR BSD-2-Clause)
%YAML 1.2
---
$id: http://devicetree.org/schemas/clock/canaan,k230-clk.yaml#
$schema: http://devicetree.org/meta-schemas/core.yaml#

title: Canaan Kendryte K230 Clock

maintainers:
  - Xukai Wang <kingxukai@zohomail.com>

properties:
  compatible:
    const: canaan,k230-clk

  reg:
    items:
      - description: PLL control registers
      - description: Sysclk control registers

  clocks:
    description:
      Specifies the reference clocks from which the output frequency is derived.
      Most of clocks are derived from osc24m and its derived clocks, a few clocks
      are derived from sysctl-apb, and one derived from sram-div2.
      And timer-pulse-in is a clock source for the timerX that uses external pulses
      input through a pin, with 50M HZ maximum frequency.
    minItems: 3
    maxItems: 4

  clock-names:
    oneOf:
      - items:
        - const: osc24m
        - const: sysctl-apb
        - const: sram-div2
      - items:
        - const: osc24m
        - const: sysctl-apb
        - const: sram-div2
        - const: timer-pulse-in

  '#clock-cells':
    const: 1

required:
  - compatible
  - reg
  - clocks
  - clock-names
  - '#clock-cells'

additionalProperties: false

examples:
  - |
    clock-controller@91102000 {
        compatible = "canaan,k230-clk";
        reg = <0x91102000 0x40>,
              <0x91100000 0x108>;
        clocks = <&osc24m>, <&sysctl_apb>, <&shrm_sram_div2>;
        clock-names = "osc24m", "sysctl-apb", "sram-div2";
        #clock-cells = <1>;
    };
```
